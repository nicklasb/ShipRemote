## src/Kconfig.projbuild
```kconfig
menu "ShipRemote"

    config BUTTON_LEFT_GPIO
        int "Left button"
        default 35

    config BUTTON_RIGHT_GPIO
        int "Right button"
        default 32

endmenu
```
